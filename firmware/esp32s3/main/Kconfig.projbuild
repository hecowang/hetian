## firmware/esp32s3/main/Kconfig.projbuild
```kconfig
menu "Hometown Keeper"

config HETIAN_WIFI_SSID
    string "Wi-Fi SSID"
    default ""

config HETIAN_WIFI_PASSWORD
    string "Wi-Fi password"
    default ""

config HETIAN_API_URL
    string "Telemetry API URL"
    default "http://192.168.1.10:8000/api/device-events"

config HETIAN_DEVICE_ID
    string "Device ID"
    default "hetian-edge-01"

config HETIAN_UART_RX_GPIO
    int "Flight controller UART RX GPIO"
    default 18

config HETIAN_UART_TX_GPIO
    int "Flight controller UART TX GPIO"
    default 17

config HETIAN_UART_BAUD
    int "Flight controller UART baud"
    default 921600

endmenu
```

## firmware/esp32s3/sdkconfig.defaults
```kconfig
CONFIG_ESP_TASK_WDT_EN=y
CONFIG_ESP_TASK_WDT_TIMEOUT_S=10
CONFIG_ESP_MAIN_TASK_STACK_SIZE=6144
CONFIG_PARTITION_TABLE_CUSTOM=y
CONFIG_PARTITION_TABLE_CUSTOM_FILENAME="partitions.csv"
```
